## main/Kconfig.projbuild
```kconfig
menu "Gas Monitor"

    config GAS_ADC_PIN
        int "Gas sensor ADC pin (GPIO number, 0-35 for ADC1)"
        range 0 35
        default 36

    config GAS_ADC_CHANNEL
        int "ADC channel (0-7, must match ADC pin)"
        range 0 7
        default 0

    config GAS_SENSOR_VCC_MV
        int "MQ-2 sensor supply voltage VCC (mV)"
        range 4500 5500
        default 5000
        help
            Voltage feeding the MQ-2 module's VCC pin. The datasheet curve
            used for the ppm estimate assumes the standard 5V supply the
            sensor's heater is designed for; powering it at 3.3V under-heats
            the sensing element and makes the ppm estimate unreliable.

    config GAS_LOAD_RESISTOR_OHM
        int "MQ-2 module load resistor RL (ohm)"
        range 1000 20000
        default 5000
        help
            Value of the load resistor on the MQ-2 breakout board, used with
            the AOUT reading to derive the sensor's resistance (Rs). Check
            your specific module's schematic/silkscreen; 5k ohm is the most
            common default on cheap breakout boards.

    config GAS_ADC_DIVIDER_PERCENT
        int "AOUT voltage divider ratio (percent reaching the ADC pin)"
        range 20 100
        default 100
        help
            If AOUT is wired directly to the ADC pin, leave at 100. If you
            added an external voltage divider (recommended, since AOUT can
            exceed the ESP32's 3.3V ADC limit) to protect the GPIO, set this
            to the percentage of the real AOUT voltage that reaches the ADC
            pin, e.g. a 1:2 divider (10k/10k to GND) reaching half of AOUT is
            50. This is needed to reconstruct the true sensor voltage before
            estimating ppm.

    config GAS_THRESHOLD_PPM
        int "Gas alarm threshold (ppm, estimated LPG concentration)"
        range 50 10000
        default 1000
        help
            Alarm fires once the estimated LPG concentration (derived from
            the MQ-2 Rs/Ro curve) reaches this value. This is an estimate
            from a low-cost, uncalibrated-grade sensor, not a certified
            safety measurement -- treat it as an early-warning trigger, not
            a LEL-certified threshold.

    config GAS_CHECK_PERIOD_MS
        int "Sensor check period (ms)"
        range 500 60000
        default 1000

    config GAS_ALARM_COOLDOWN_S
        int "Cooldown between alarm sends (s)"
        range 5 600
        default 60

    config GAS_LED_GPIO
        int "Alarm LED GPIO pin"
        range 0 33
        default 2
        help
            GPIO driving the local warning LED. Lights up whenever the gas
            reading is above the alarm threshold, independent of Wi-Fi or
            Discord status. Default (2) is the onboard LED on most ESP32
            DevKit boards.

    config GAS_WIFI_SSID
        string "Wi-Fi SSID"

    config GAS_WIFI_PASSWORD
        string "Wi-Fi password"

    config GAS_DISCORD_WEBHOOK
        string "Discord webhook URL (https://discord.com/api/webhooks/...)"

    config GAS_DEVICE_NAME
        string "Device name (shown in Discord message)"
        default "Gas-Monitor-01"

    config GAS_MQTT_BROKER_URI
        string "MQTT broker URI (mqtt://host:port), empty to disable"
        default "mqtt://172.16.20.130:1883"
        help
            Address of the Mosquitto/MQTT broker reachable from the ESP32
            (e.g. the LAN IP of the machine running the Node-RED + Mosquitto
            docker-compose stack). Leave empty to disable MQTT publishing.
            Readings are published to "airgas/<device>/reading" and alarms
            to "airgas/<device>/alarm". Also used by the MQ-135 air quality
            sensor below, publishing to "airquality/<device>/reading".

    menu "MQ-135 Air Quality Sensor"

        config AQ_ENABLE
            bool "Enable MQ-135 air quality sensor"
            default y
            help
                MQ-135 is a second, independent gas sensor (CO2-equivalent /
                general air quality) wired to its own ADC pin, separate from
                the MQ-2 gas-leak sensor above.

        config AQ_ADC_PIN
            int "MQ-135 ADC pin (GPIO number, 0-39 for ADC1)"
            depends on AQ_ENABLE
            range 0 39
            default 39

        config AQ_ADC_CHANNEL
            int "MQ-135 ADC channel (0-7, must match ADC pin)"
            depends on AQ_ENABLE
            range 0 7
            default 3
            help
                Default (channel 3) corresponds to GPIO39 (ADC1_CH3) on the
                standard ESP32.

        config AQ_SENSOR_VCC_MV
            int "MQ-135 sensor supply voltage VCC (mV)"
            depends on AQ_ENABLE
            range 4500 5500
            default 5000

        config AQ_LOAD_RESISTOR_OHM
            int "MQ-135 module load resistor RL (ohm)"
            depends on AQ_ENABLE
            range 1000 22000
            default 20000
            help
                Check your specific module's schematic/silkscreen; 20k ohm
                is common on MQ-135 breakout boards but varies by supplier.

        config AQ_ADC_DIVIDER_PERCENT
            int "MQ-135 AOUT voltage divider ratio (percent reaching the ADC pin)"
            depends on AQ_ENABLE
            range 20 100
            default 100

        config AQ_THRESHOLD_PPM
            int "Poor air quality threshold (ppm, estimated CO2-equivalent)"
            depends on AQ_ENABLE
            range 500 5000
            default 1500
            help
                Indoor CO2 above roughly 1000-1500ppm is commonly considered
                a sign of poor ventilation (ASHRAE guidance); above ~2000ppm
                is considered poor. This is an uncalibrated-grade estimate,
                not a certified air-quality measurement.

    endmenu

endmenu
```

## sdkconfig.defaults
```kconfig
CONFIG_ESP_WIFI_ENABLED=y
CONFIG_ESP_WIFI_STA_ENABLED=y
CONFIG_ESP_WIFI_802_11_N_SUPPORT=y
CONFIG_ESP_WIFI_802_11_K_SUPPORT=y
CONFIG_PARTITION_TABLE_SINGLE_APP=y
CONFIG_BOOTLOADER_LOG_LEVEL_INFO=y
CONFIG_LOG_DEFAULT_LEVEL_INFO=y
CONFIG_FREERTOS_HZ=1000
```
